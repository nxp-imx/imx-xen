## xen/arch/arm/tee/Kconfig
```kconfig
config OPTEE
	bool "Enable OP-TEE mediator"
	default n
	depends on TEE
	help
	  Enable the OP-TEE mediator. It allows guests to access
	  OP-TEE running on your platform. This requires
	  virtualization-enabled OP-TEE present. You can learn more
	  about virtualization for OP-TEE at
	  https://optee.readthedocs.io/architecture/virtualization.html

config TRUSTY
	bool "Enable Trusty mediator"
	default y
	depends on TEE
	help
	  Enable the Trusty mediator. It allows DomU android use
	  trusty services. For a better solution, we might need
	  to emulate secure world in a XEN VM.
```
